#include <Adafruit_SSD1306.h>
#define OLED_RESET 4
Adafruit_SSD1306 display(OLED_RESET);
char keyword;
// 'thankyousignlagnuage', 128x64px
const unsigned char thank [] PROGMEM = {  
  0xff, 0xff, 0xff, 0xff, 0xff, 0xff, 0xc0, 0x07, 0xff, 0xff, 0xff, 0xff, 0xff, 0xff, 0x9f, 0xff, 
  0xff, 0xff, 0xff, 0xff, 0xff, 0xff, 0x80, 0x07, 0xff, 0xff, 0xfe, 0x00, 0x07, 0xff, 0x8f, 0xff, 
  0xff, 0xff, 0xff, 0xff, 0xff, 0xfe, 0x7f, 0xf8, 0x3f, 0xff, 0xf8, 0x00, 0x00, 0xff, 0x1f, 0xff, 
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  0x00, 0x00, 0x00, 0x00, 0xfc, 0x00, 0x00, 0x3f, 0xff, 0xff, 0xe0, 0x00, 0x00, 0x00, 0x00, 0x00
};
// 'hellobitmap', 128x64px
const unsigned char hello [] PROGMEM = {
  0xff, 0xe0, 0x00, 0xff, 0xff, 0xff, 0xff, 0xff, 0x00, 0x1f, 0xff, 0xff, 0xff, 0x80, 0x03, 0xff, 
  0xf7, 0xe0, 0x01, 0xff, 0xff, 0xff, 0xff, 0xfe, 0x7f, 0xc7, 0xff, 0xff, 0xff, 0xc0, 0x03, 0xf7, 
  0xf1, 0xe0, 0x00, 0x7f, 0xff, 0xff, 0xff, 0xfc, 0xff, 0xf3, 0xff, 0xff, 0xfe, 0x00, 0x03, 0xc7, 
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  0xff, 0xff, 0xff, 0xe0, 0x00, 0x00, 0x00, 0x00, 0x00, 0x00, 0x00, 0x00, 0x00, 0x00, 0x00, 0x00
};
// 'goodbyebitmap', 46x64px
const unsigned char goodbye [] PROGMEM = {
  0xff, 0xff, 0xf2, 0x3f, 0xff, 0xfc, 0xff, 0xff, 0xe3, 0x07, 0xff, 0xfc, 0xff, 0xfe, 0x07, 0x23, 
  0xff, 0xfc, 0xff, 0xfc, 0x0f, 0x33, 0xff, 0xfc, 0xff, 0xfc, 0xcf, 0x33, 0xff, 0xfc, 0xff, 0xf9, 
  0xce, 0x33, 0xff, 0xfc, 0xff, 0xf9, 0xce, 0x73, 0xff, 0xfc, 0xff, 0xf3, 0xde, 0x73, 0xff, 0xfc, 
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  0xf9, 0xff, 0xff, 0xfc, 0xbf, 0xff, 0xf9, 0xff, 0xff, 0xfc, 0x3f, 0xff, 0xf9, 0xff, 0xff, 0xfc
};
// 'welcomebitmap', 45x64px
const unsigned char welcome [] PROGMEM = {
  0xff, 0xff, 0xfc, 0x07, 0xff, 0xf0, 0xfe, 0x7f, 0xff, 0xff, 0xff, 0xf0, 0xff, 0x7f, 0xff, 0xff, 
  0xff, 0xe0, 0xff, 0x7f, 0xff, 0xff, 0xff, 0xe8, 0xff, 0x3f, 0xff, 0xff, 0xff, 0xc8, 0xff, 0xbf, 
  0xff, 0xff, 0xff, 0xc8, 0xff, 0x9f, 0x80, 0x03, 0xff, 0xd8, 0xff, 0xcf, 0x31, 0xb8, 0xff, 0x98, 
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  0xf3, 0xff, 0xff, 0xf8, 0xff, 0xff, 0xff, 0xff, 0xff, 0xf8, 0xff, 0xff, 0xff, 0xff, 0xff, 0xf8
};

void setup() {
  Serial.begin(9600);
  display.begin(SSD1306_SWITCHCAPVCC, 0x3C); 
  display.setTextColor(WHITE);
}
void drawBitMap_thank(int x, int y)
{
  display.drawBitmap(x, y,  thank, 128, 52, 1);
}
void drawBitMap_hello(int x, int y)
{
  display.drawBitmap(x, y,  hello, 128, 51, 1);
}
void drawBitMap_goodbye(int x, int y)
{
  display.drawBitmap(x, y,  goodbye, 46, 64, 1);
}
void drawBitMap_welcome(int x, int y)
{
  display.drawBitmap(x, y,  welcome, 45, 64, 1);
}
void loop() {
  if (Serial.available() > 0)
  {
    keyword = Serial.read();
    if (keyword == '1')
    {
      display.clearDisplay();
      drawBitMap_thank(0, 0);
      display.display();
      delay(1000);
      display.clearDisplay();
      display.display();
    }
    if (keyword == '2')
    {
      display.clearDisplay();
      drawBitMap_hello(0, 0);
      display.display();
      delay(1000);
      display.clearDisplay();
      display.display();   
    }
    if (keyword == '3')
    {
      display.clearDisplay();
      drawBitMap_goodbye(0, 0);
      display.display();
      delay(1000);
      display.clearDisplay();
      display.display(); 
    }
    if (keyword == '4')
    {
      display.clearDisplay();
      drawBitMap_welcome(0, 0);
      display.display();
      delay(1000);
      display.clearDisplay();
      display.display();  
    }
  }
}



